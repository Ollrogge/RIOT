## sys/crypto/modes/Kconfig
```kconfig
# Copyright (c) 2021 HAW Hamburg
#
# This file is subject to the terms and conditions of the GNU Lesser
# General Public License v2.1. See the file LICENSE in the top level
# directory for more details.
#

config MODULE_CIPHER_MODES_CBC
    bool "Cipher CBC Mode"
    select MODULE_CIPHER_MODES

config MODULE_CIPHER_MODES_CCM
    bool "Cipher CCM Mode"
    select MODULE_CIPHER_MODES

config MODULE_CIPHER_MODES_CTR
    bool "Cipher CCM Mode"
    select MODULE_CIPHER_MODES

config MODULE_CIPHER_MODES
    bool "Modes for block ciphers"
    depends on MODULE_CRYPTO
    help
        Include common code for block cipher modes, such as CBC, ECB or OCB.
```

## sys/fido2/ctap/Kconfig
```kconfig
# Copyright (C) 2021 Freie Universität Berlin
#
# This file is subject to the terms and conditions of the GNU Lesser
# General Public License v2.1. See the file LICENSE in the top level
# directory for more details.

menuconfig KCONFIG_USEMODULE_FIDO2_CTAP
    bool "FIDO2 CTAP"
    depends on USEMODULE_FIDO2_CTAP
    help
        Configure a FIDO2 CTAP authenticator via KConfig.

if KCONFIG_USEMODULE_FIDO2_CTAP

config FIDO2_CTAP_STACK_SIZE
    int "CTAP thread stack size"
    default 15000

config FIDO2_CTAP_DEVICE_AAGUID
    string "AAGUID of the CTAP authenticator"
    default "9c295865fa2c36b705a42320af9c8f16"
    help
        The AAGUID is identifying the type of the authenticator (e.g manufacturer
        and model). The AAGUID needs to be 128 bits long. The default value here
        is a fallback value that was randomly generated.

config FIDO2_CTAP_DISABLE_UP
    bool "Disable user presence tests"
    help
        When set, the authenticator will not ask for permission before creating
        a new credential pair or authenticating.

config FIDO2_CTAP_DISABLE_LED
    bool "Disable LED animations"
    help
        When set, the authenticator will not use LED's.

config FIDO2_CTAP_UP_TIMEOUT
    int "Seconds until user presence test times out"
    default 15

rsource "transport/Kconfig"

endif # KCONFIG_FIDO2_CTAP
```

## sys/net/gnrc/Kconfig
```kconfig
# Copyright (c) 2019 HAW Hamburg
#
# This file is subject to the terms and conditions of the GNU Lesser
# General Public License v2.1. See the file LICENSE in the top level
# directory for more details.
#

menuconfig MODULE_GNRC
    bool "Gnrc network stack"
    select MODULE_GNRC_NETAPI
    select MODULE_GNRC_NETREG
    select MODULE_GNRC_NETIF
    select MODULE_GNRC_NETIF_HDR
    select MODULE_GNRC_PKTBUF_STATIC

if MODULE_GNRC

rsource "application_layer/dhcpv6/Kconfig"
rsource "link_layer/gomach/Kconfig"
rsource "link_layer/lorawan/Kconfig"
rsource "link_layer/lwmac/Kconfig"
rsource "link_layer/mac/Kconfig"
rsource "netif/Kconfig"
rsource "network_layer/ipv6/Kconfig"
rsource "network_layer/sixlowpan/Kconfig"
rsource "pktbuf/Kconfig"
rsource "pktbuf_static/Kconfig"
rsource "pktdump/Kconfig"
rsource "routing/rpl/Kconfig"
rsource "transport_layer/tcp/Kconfig"
rsource "netreg/Kconfig"
rsource "netapi/Kconfig"

endif # MODULE_GNRC
```

## sys/net/gnrc/link_layer/lorawan/Kconfig
```kconfig
# Copyright (c) 2019 HAW Hamburg
#
# This file is subject to the terms and conditions of the GNU Lesser
# General Public License v2.1. See the file LICENSE in the top level
# directory for more details.
#

menuconfig MODULE_GNRC_LORAWAN_1_1
    bool "LoRaWAN 1.1"
    select HAVE_LORAWAN
    select MODULE_GNRC_LORAWAN

config MODULE_GNRC_LORAWAN
    bool
    select HAVE_LORAWAN
    select MODULE_GNRC_NETIF_LORAWAN
    select MODULE_GNRC_NETTYPE_LORAWAN

config MODULE_GNRC_NETTYPE_LORAWAN
    bool

menuconfig KCONFIG_USEMODULE_GNRC_LORAWAN
    bool "Configure GNRC LoRaWAN"
    depends on USEMODULE_GNRC_LORAWAN
    help
        Configure GNRC LoRaWAN module using Kconfig.

if KCONFIG_USEMODULE_GNRC_LORAWAN

config GNRC_LORAWAN_MIN_SYMBOLS_TIMEOUT
    int "Minimum symbols to detect a LoRa preamble"
    default 30
    range 0 1024

endif # KCONFIG_USEMODULE_GNRC_LORAWAN
```

## sys/net/gnrc/netif/init_devs/Kconfig
```kconfig
config MODULE_AUTO_INIT_GNRC_NETIF
    bool "auto init"
    select MODULE_GNRC_NETIF_INIT_DEVS

config MODULE_GNRC_NETIF_INIT_DEVS
    bool "auto init gnrc netif"
```

## sys/net/gnrc/pktbuf_static/Kconfig
```kconfig
menuconfig MODULE_GNRC_PKTBUF_STATIC
    bool "gnrc_pktbuf"
    select MODULE_GNRC_PKTBUF
```
